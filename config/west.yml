## config/west.yml
```yaml
manifest:
  remotes:
    - name: zmkfirmware
      url-base: https://github.com/Phaloen/zmk
  projects:
    - name: zmk
      remote: zmkfirmware
      revision: paintbrushchorder
      import: app/west.yml
  self:
    path: config
```
